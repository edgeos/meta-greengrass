## meta-edgeos-raspberrypi/conf/layer.conf
```bitbake
# We have a conf and classes directory, add to BBPATH
BBPATH .= ":${LAYERDIR}"

# We have recipes-* directories, add to BBFILES
BBFILES += "${LAYERDIR}/recipes-*/*/*.bb \
            ${LAYERDIR}/recipes-*/*/*.bbappend"

BBFILE_COLLECTIONS += "greengrass-edgeos-raspberrypi"
BBFILE_PATTERN_greengrass-edgeos-raspberrypi = "^${LAYERDIR}/"
BBFILE_PRIORITY_greengrass-edgeos-raspberrypi = "51"

GREENGRASS_EDGEOS_COREBASE := '${@os.path.normpath("${LAYERDIR}/")}'

#Remove some warnings in newer versions of bitbake
LAYERSERIES_COMPAT_greengrass-edgeos = "pyro rocko sumo"
```

## meta-edgeos/conf/layer.conf
```bitbake
# We have a conf and classes directory, add to BBPATH
BBPATH .= ":${LAYERDIR}"

# We have recipes-* directories, add to BBFILES
BBFILES += "${LAYERDIR}/recipes-*/*/*.bb \
            ${LAYERDIR}/recipes-*/*/*.bbappend"

BBFILE_COLLECTIONS += "greengrass-edgeos"
BBFILE_PATTERN_greengrass-edgeos = "^${LAYERDIR}/"
BBFILE_PRIORITY_greengrass-edgeos = "51"

GREENGRASS_EDGEOS_COREBASE := '${@os.path.normpath("${LAYERDIR}/")}'

#Remove some warnings in newer versions of bitbake
LAYERSERIES_COMPAT_greengrass-edgeos = "pyro rocko sumo"
```

## meta-greengrass-common/conf/layer.conf
```bitbake
# We have a conf and classes directory, add to BBPATH
BBPATH .= ":${LAYERDIR}"

# We have recipes-* directories, add to BBFILES
BBFILES += "${LAYERDIR}/recipes-*/*/*.bb \
            ${LAYERDIR}/recipes-*/*/*.bbappend"

BBFILE_COLLECTIONS += "greengrass"
BBFILE_PATTERN_greengrass = "^${LAYERDIR}/"
BBFILE_PRIORITY_greengrass = "9"

GREENGRASS_COREBASE := '${@os.path.normpath("${LAYERDIR}/")}'

#Remove some warnings in newer versions of bitbake
LAYERSERIES_COMPAT_greengrass = "pyro rocko sumo"

CMDLINE_append_rpi = " cgroup_memory=1 cgroup_enable=memory "
```
